## apps/Kconfig
```kconfig
#
# Copyright (c) 2014-2015 Google, Inc.
# All rights reserved.
#
# Redistribution and use in source and binary forms, with or without
# modification, are permitted provided that the following conditions are met:
# 1. Redistributions of source code must retain the above copyright notice,
# this list of conditions and the following disclaimer.
# 2. Redistributions in binary form must reproduce the above copyright notice,
# this list of conditions and the following disclaimer in the documentation
# and/or other materials provided with the distribution.
# 3. Neither the name of the copyright holder nor the names of its
# contributors may be used to endorse or promote products derived from this
# software without specific prior written permission.
#
# THIS SOFTWARE IS PROVIDED BY THE COPYRIGHT HOLDERS AND CONTRIBUTORS "AS IS"
# AND ANY EXPRESS OR IMPLIED WARRANTIES, INCLUDING, BUT NOT LIMITED TO,
# THE IMPLIED WARRANTIES OF MERCHANTABILITY AND FITNESS FOR A PARTICULAR
# PURPOSE ARE DISCLAIMED. IN NO EVENT SHALL THE COPYRIGHT HOLDER OR
# CONTRIBUTORS BE LIABLE FOR ANY DIRECT, INDIRECT, INCIDENTAL, SPECIAL,
# EXEMPLARY, OR CONSEQUENTIAL DAMAGES (INCLUDING, BUT NOT LIMITED TO,
# PROCUREMENT OF SUBSTITUTE GOODS OR SERVICES; LOSS OF USE, DATA, OR PROFITS;
# OR BUSINESS INTERRUPTION) HOWEVER CAUSED AND ON ANY THEORY OF LIABILITY,
# WHETHER IN CONTRACT, STRICT LIABILITY, OR TORT (INCLUDING NEGLIGENCE OR
# OTHERWISE) ARISING IN ANY WAY OUT OF THE USE OF THIS SOFTWARE, EVEN IF
# ADVISED OF THE POSSIBILITY OF SUCH DAMAGE.
#
# For a description of the syntax of this configuration file,
# see misc/tools/kconfig-language.txt.
#

menu "Built-In Applications"
source "$APPSDIR/builtin/Kconfig"
endmenu

menu "Ara Applications"
source "$APPSDIR/ara/Kconfig"
endmenu

menuconfig GREYBUS_UTILS
	bool "Greybus utility"
	default n

if GREYBUS_UTILS
source "$APPSDIR/greybus-utils/Kconfig"
endif

menu "Examples"
source "$APPSDIR/examples/Kconfig"
endmenu

menu "Graphics Support"
source "$APPSDIR/graphics/Kconfig"
endmenu

menu "Interpreters"
source "$APPSDIR/interpreters/Kconfig"
endmenu

menu "Network Utilities"
source "$APPSDIR/netutils/Kconfig"
endmenu

menu "NSH Library"
source "$APPSDIR/nshlib/Kconfig"
endmenu

menu "NxWidgets/NxWM"
source "$APPSDIR/NxWidgets/Kconfig"
endmenu

menu "Platform-specific Support"
source "$APPSDIR/platform/Kconfig"
endmenu

menu "System Libraries and NSH Add-Ons"
source "$APPSDIR/system/Kconfig"
endmenu

menu "Mods"
source "$APPSDIR/mods/Kconfig"
endmenu
```

## apps/ara/Kconfig
```kconfig
#
# Copyright (c) 2014-2015 Google, Inc.
# All rights reserved.
#
# Redistribution and use in source and binary forms, with or without
# modification, are permitted provided that the following conditions are met:
# 1. Redistributions of source code must retain the above copyright notice,
# this list of conditions and the following disclaimer.
# 2. Redistributions in binary form must reproduce the above copyright notice,
# this list of conditions and the following disclaimer in the documentation
# and/or other materials provided with the distribution.
# 3. Neither the name of the copyright holder nor the names of its
# contributors may be used to endorse or promote products derived from this
# software without specific prior written permission.
#
# THIS SOFTWARE IS PROVIDED BY THE COPYRIGHT HOLDERS AND CONTRIBUTORS "AS IS"
# AND ANY EXPRESS OR IMPLIED WARRANTIES, INCLUDING, BUT NOT LIMITED TO,
# THE IMPLIED WARRANTIES OF MERCHANTABILITY AND FITNESS FOR A PARTICULAR
# PURPOSE ARE DISCLAIMED. IN NO EVENT SHALL THE COPYRIGHT HOLDER OR
# CONTRIBUTORS BE LIABLE FOR ANY DIRECT, INDIRECT, INCIDENTAL, SPECIAL,
# EXEMPLARY, OR CONSEQUENTIAL DAMAGES (INCLUDING, BUT NOT LIMITED TO,
# PROCUREMENT OF SUBSTITUTE GOODS OR SERVICES; LOSS OF USE, DATA, OR PROFITS;
# OR BUSINESS INTERRUPTION) HOWEVER CAUSED AND ON ANY THEORY OF LIABILITY,
# WHETHER IN CONTRACT, STRICT LIABILITY, OR TORT (INCLUDING NEGLIGENCE OR
# OTHERWISE) ARISING IN ANY WAY OUT OF THE USE OF THIS SOFTWARE, EVEN IF
# ADVISED OF THE POSSIBILITY OF SUCH DAMAGE.
#
# For a description of the syntax of this configuration file,
# see misc/tools/kconfig-language.txt.
#

source "$APPSDIR/ara/debug/Kconfig"
source "$APPSDIR/ara/etm/Kconfig"
source "$APPSDIR/ara/svc_power/Kconfig"
source "$APPSDIR/ara/svc/Kconfig"
source "$APPSDIR/ara/unipro/Kconfig"
source "$APPSDIR/ara/apbridge/Kconfig"
source "$APPSDIR/ara/gpbridge/Kconfig"
source "$APPSDIR/ara/pwm/Kconfig"
source "$APPSDIR/ara/pwm_unit_test/Kconfig"
source "$APPSDIR/ara/sdio_unit_test/Kconfig"
source "$APPSDIR/ara/gpio/Kconfig"
source "$APPSDIR/ara/arapm/Kconfig"
source "$APPSDIR/ara/springpm/Kconfig"
source "$APPSDIR/ara/spi/Kconfig"
source "$APPSDIR/ara/usb-host/Kconfig"
source "$APPSDIR/ara/gb_loopback/Kconfig"
source "$APPSDIR/ara/i2s/Kconfig"
source "$APPSDIR/ara/bringup_entry/Kconfig"
source "$APPSDIR/ara/service_mgr/Kconfig"
source "$APPSDIR/ara/gb_tape/Kconfig"
source "$APPSDIR/ara/dev_info/Kconfig"
source "$APPSDIR/ara/time/Kconfig"
source "$APPSDIR/ara/battery/Kconfig"
```

## apps/ara/apbridge-unipro/Kconfig
```kconfig
#
# For a description of the syntax of this configuration file,
# see misc/tools/kconfig-language.txt.
#

config APBRIDGE_UNIPRO
	bool "APBridge FW with UniPro layer"
	select GREYBUS_UTILS
	default n

config APBRIDGE_GBSIM
	bool "Enable GBSIM mode"
	depends on APBRIDGE_UNIPRO
	default n
```

## apps/ara/apbridge/Kconfig
```kconfig
#
# Copyright (c) 2015 Google, Inc.
# All rights reserved.
#
# Redistribution and use in source and binary forms, with or without
# modification, are permitted provided that the following conditions are met:
# 1. Redistributions of source code must retain the above copyright notice,
# this list of conditions and the following disclaimer.
# 2. Redistributions in binary form must reproduce the above copyright notice,
# this list of conditions and the following disclaimer in the documentation
# and/or other materials provided with the distribution.
# 3. Neither the name of the copyright holder nor the names of its
# contributors may be used to endorse or promote products derived from this
# software without specific prior written permission.
#
# THIS SOFTWARE IS PROVIDED BY THE COPYRIGHT HOLDERS AND CONTRIBUTORS "AS IS"
# AND ANY EXPRESS OR IMPLIED WARRANTIES, INCLUDING, BUT NOT LIMITED TO,
# THE IMPLIED WARRANTIES OF MERCHANTABILITY AND FITNESS FOR A PARTICULAR
# PURPOSE ARE DISCLAIMED. IN NO EVENT SHALL THE COPYRIGHT HOLDER OR
# CONTRIBUTORS BE LIABLE FOR ANY DIRECT, INDIRECT, INCIDENTAL, SPECIAL,
# EXEMPLARY, OR CONSEQUENTIAL DAMAGES (INCLUDING, BUT NOT LIMITED TO,
# PROCUREMENT OF SUBSTITUTE GOODS OR SERVICES; LOSS OF USE, DATA, OR PROFITS;
# OR BUSINESS INTERRUPTION) HOWEVER CAUSED AND ON ANY THEORY OF LIABILITY,
# WHETHER IN CONTRACT, STRICT LIABILITY, OR TORT (INCLUDING NEGLIGENCE OR
# OTHERWISE) ARISING IN ANY WAY OUT OF THE USE OF THIS SOFTWARE, EVEN IF
# ADVISED OF THE POSSIBILITY OF SUCH DAMAGE.
#
# For a description of the syntax of this configuration file,
# see misc/tools/kconfig-language.txt.
#

config APBRIDGEA
	bool "APBridgeA FW"
	select GREYBUS_UTILS
	select USBDEV_DMA
	default n
	---help---
		Enable Firmware for APBridgeA which is the APBridge
		on the AP module.  Do not select this for APBridgeE
		('E' for endpoint) which is the APBridge on anything
		that is not the AP module.  Do not select this for
		GPBridge either.

choice
	prompt "Select the backend"
config APBRIDGEA_UNIPRO
	bool "Enable bridge mode on APBridgeA"
	depends on APBRIDGEA
	---help---
		The firmware will act as bridge between UniPro and USB.
config APBRIDGEA_DUMMY
	bool "Enable dummy mode on APBridgeA"
	depends on APBRIDGEA
	---help---
		Enable dummy backend on APBridgeA.
		The firmware will just enumerate.
		This backend is only useful to test hardware.
endchoice
```

## apps/ara/bdbpm/Kconfig
```kconfig
#
# For a description of the syntax of this configuration file,
# see misc/tools/kconfig-language.txt.
#
# Copyright (c) 2015 Google Inc.
# All rights reserved.
#
# Redistribution and use in source and binary forms, with or without
# modification, are permitted provided that the following conditions are met:
# 1. Redistributions of source code must retain the above copyright notice,
# this list of conditions and the following disclaimer.
# 2. Redistributions in binary form must reproduce the above copyright notice,
# this list of conditions and the following disclaimer in the documentation
# and/or other materials provided with the distribution.
# 3. Neither the name of the copyright holder nor the names of its
# contributors may be used to endorse or promote products derived from this
# software without specific prior written permission.
#
# THIS SOFTWARE IS PROVIDED BY THE COPYRIGHT HOLDERS AND CONTRIBUTORS "AS IS"
# AND ANY EXPRESS OR IMPLIED WARRANTIES, INCLUDING, BUT NOT LIMITED TO,
# THE IMPLIED WARRANTIES OF MERCHANTABILITY AND FITNESS FOR A PARTICULAR
# PURPOSE ARE DISCLAIMED. IN NO EVENT SHALL THE COPYRIGHT HOLDER OR
# CONTRIBUTORS BE LIABLE FOR ANY DIRECT, INDIRECT, INCIDENTAL, SPECIAL,
# EXEMPLARY, OR CONSEQUENTIAL DAMAGES (INCLUDING, BUT NOT LIMITED TO,
# PROCUREMENT OF SUBSTITUTE GOODS OR SERVICES; LOSS OF USE, DATA, OR PROFITS;
# OR BUSINESS INTERRUPTION) HOWEVER CAUSED AND ON ANY THEORY OF LIABILITY,
# WHETHER IN CONTRACT, STRICT LIABILITY, OR TORT (INCLUDING NEGLIGENCE OR
# OTHERWISE) ARISING IN ANY WAY OUT OF THE USE OF THIS SOFTWARE, EVEN IF
# ADVISED OF THE POSSIBILITY OF SUCH DAMAGE.
#

config ARA_SVC_BDBPM
	bool "Ara SVC Power Measurement"
	default n
	depends on ARCH_BOARD_ARA_SVC
	---help---
		Enable the Ara SVC Power Measurement Application

if ARA_SVC_BDBPM

config ARA_SVC_BDBPM_PROGNAME
	string "Ara SVC Power Measurement Application"
	default "bdbpm"
	depends on BUILD_KERNEL
	---help---
		This is the name of the program that will be use when the NSH ELF
		program is installed.

endif
```

## apps/ara/debug/Kconfig
```kconfig
#
# For a description of the syntax of this configuration file,
# see misc/tools/kconfig-language.txt.
#
# Copyright (C) 2014 Google, Inc.
# Google Confidential/Restricted
#

config ARA_SVC_DEBUG
	bool "Ara SVC debug"
	default n
	depends on ARCH_BOARD_ARA_BDB_SVC || ARCH_BOARD_ARA_ENDO_SVC
	---help---
		Enable the Ara Debug program. Controls the debug output messages

if ARA_SVC_DBUG

config ARA_SVC_DEBUG_PROGNAME
	string "Program name"
	default "debug"
	depends on BUILD_KERNEL
	---help---
		This is the name of the program that will be used when the
		NSH ELF program is installed.

endif
```

## apps/ara/epm/Kconfig
```kconfig
#
# For a description of the syntax of this configuration file,
# see misc/tools/kconfig-language.txt.
#
# Copyright (C) 2014 Google, Inc.
#

config ARA_SVC_EPM
	bool "Ara SVC EPM control"
	default n
	depends on ARCH_BOARD_ARA_BDB_SVC
	---help---
		Enable the Ara EPM program. Controls the EPM states


if ARA_SVC_EPM

config ARA_SVC_EPM_PROGNAME
	string "Program name"
	default "epm"
	depends on BUILD_KERNEL
	---help---
		This is the name of the program that will be use when the NSH ELF
		program is installed.

endif
```

## apps/ara/etm/Kconfig
```kconfig
#
# For a description of the syntax of this configuration file,
# see misc/tools/kconfig-language.txt.
#

config ARA_BRIDGE_ETM
	bool "Ara Bridge ETM control"
	default n if !DEBUG
	default y if DEBUG
	depends on ARCH_CHIP_TSB
	---help---
		Enable the Ara ETM program. Controls TRACE output from ETM.


if ARA_BRIDGE_ETM

config ARA_BRIDGE_ETM_PROGNAME
	string "Program name"
	default "etm"
	depends on BUILD_KERNEL
	---help---
		This is the name of the program that will be use when the
		NSH ELF program is installed.

endif
```

## apps/ara/gb_loopback/Kconfig
```kconfig
#
# For a description of the syntax of this configuration file,
# see misc/tools/kconfig-language.txt.
#

config ARA_GB_LOOPBACK
	bool "Ara gb_loopback app"
	default n
	depends on ARCH_CHIP_TSB
	---help---
		Enable the Ara gb_loopback test program

config ARA_GB_LOOPBACK_PROGNAME
	string "Program name"
	default "gb_loopback"
	depends on BUILD_KERNEL
	---help---
		This is the name of the program that will be use when the NSH ELF
		program is installed.
```

## apps/ara/gpbridge/Kconfig
```kconfig
#
# For a description of the syntax of this configuration file,
# see misc/tools/kconfig-language.txt.
#

config GPBRIDGE
	bool "GPBridge FW with UniPro layer"
	select GREYBUS_UTILS
	select GREYBUS_CONTROL_PROTOCOL
	default n
```

## apps/ara/gpio/Kconfig
```kconfig
#
# Copyright (c) 2015 Google, Inc.
# All rights reserved.
#
# Redistribution and use in source and binary forms, with or without
# modification, are permitted provided that the following conditions are met:
# 1. Redistributions of source code must retain the above copyright notice,
# this list of conditions and the following disclaimer.
# 2. Redistributions in binary form must reproduce the above copyright notice,
# this list of conditions and the following disclaimer in the documentation
# and/or other materials provided with the distribution.
# 3. Neither the name of the copyright holder nor the names of its
# contributors may be used to endorse or promote products derived from this
# software without specific prior written permission.
#
# THIS SOFTWARE IS PROVIDED BY THE COPYRIGHT HOLDERS AND CONTRIBUTORS "AS IS"
# AND ANY EXPRESS OR IMPLIED WARRANTIES, INCLUDING, BUT NOT LIMITED TO,
# THE IMPLIED WARRANTIES OF MERCHANTABILITY AND FITNESS FOR A PARTICULAR
# PURPOSE ARE DISCLAIMED. IN NO EVENT SHALL THE COPYRIGHT HOLDER OR
# CONTRIBUTORS BE LIABLE FOR ANY DIRECT, INDIRECT, INCIDENTAL, SPECIAL,
# EXEMPLARY, OR CONSEQUENTIAL DAMAGES (INCLUDING, BUT NOT LIMITED TO,
# PROCUREMENT OF SUBSTITUTE GOODS OR SERVICES; LOSS OF USE, DATA, OR PROFITS;
# OR BUSINESS INTERRUPTION) HOWEVER CAUSED AND ON ANY THEORY OF LIABILITY,
# WHETHER IN CONTRACT, STRICT LIABILITY, OR TORT (INCLUDING NEGLIGENCE OR
# OTHERWISE) ARISING IN ANY WAY OUT OF THE USE OF THIS SOFTWARE, EVEN IF
# ADVISED OF THE POSSIBILITY OF SUCH DAMAGE.
#
# For a description of the syntax of this configuration file,
# see misc/tools/kconfig-language.txt.
#

config ARA_GPIO
	bool "Ara GPIO app"
	default n if !DEBUG
	default y if DEBUG
	depends on ARCH_CHIP_TSB || ARCH_BOARD_ARA_SVC || GPIO_CHIP_STM32 && GPIO
	---help---
		Enable the Ara GPIO test program

if ARA_GPIO

config ARA_GPIO_PROGNAME
	string "Program name"
	default "gpio"
	depends on BUILD_KERNEL
	---help---
		This is the name of the program that will be use when the
		NSH ELF program is installed.

endif
```

## apps/ara/i2s/Kconfig
```kconfig
#
# For a description of the syntax of this configuration file,
# see misc/tools/kconfig-language.txt.
#

config ARA_I2S_TEST
	bool "Ara TSB I2S Device Driver Test Program"
	default n
	depends on ARCH_CHIP_TSB && !GREYBUS_I2S_PHY
	---help---
		Enable the Toshiba I2S low-level device driver test program.
		Note that this program does not exit.

if ARA_I2S_TEST

config ARA_I2S_TEST_PROGNAME
	string "Program name"
	default "i2s_test"
	---help---
		This is the name of the program that will be used when the
		NSH ELF program is installed.

endif
```

## apps/ara/lg/Kconfig
```kconfig
#
# For a description of the syntax of this configuration file,
# see misc/tools/kconfig-language.txt.
#

config ARA_LG_MAIN
	bool "Ara LG4892 test application"
	default y
	depends on ARCH_CHIP_TSB
	---help---
		Enable the Ara LG4892 LCD Panel and Touchscreen test
		application.

if ARA_LG_MAIN

config ARA_LG_MAIN_PROGNAME
	string "Program name"
	default "lg"
	depends on BUILD_KERNEL
	---help---
		This is the name of the program that will be use when the
		NSH ELF program is installed.

endif
```
