## apps/ara/pinshare/Kconfig
```kconfig
#
# For a description of the syntax of this configuration file,
# see misc/tools/kconfig-language.txt.
#

config ARA_BRIDGE_PINSHARE
	bool "Ara Bridge PINSHARE control"
	default n if !DEBUG
	default y if DEBUG
	depends on ARCH_CHIP_TSB
	---help---
		Enable the Ara PINSHARE program.  Reads, sets, and clears PINSHARE.


if ARA_BRIDGE_PINSHARE

config ARA_BRIDGE_PINSHARE_PROGNAME
	string "Program name"
	default "pinshare"
	depends on BUILD_KERNEL
	---help---
		This is the name of the program that will be used when the
		NSH ELF program is installed.

endif
```

## apps/ara/pwm/Kconfig
```kconfig
#
# For a description of the syntax of this configuration file,
# see misc/tools/kconfig-language.txt.
#

config ARA_BRIDGE_PWM
	bool "Ara Bridge PWM control"
	default n if !DEBUG
	default y if DEBUG
	depends on ARCH_CHIP_TSB
	select PWM
	---help---
		Enable the Ara PWM program.  Controls and tests PWM0 and PWM1.


if ARA_BRIDGE_PWM

config ARA_BRIDGE_PWM_PROGNAME
	string "Program name"
	default "pwm"
	depends on BUILD_KERNEL
	---help---
		This is the name of the program that will be use when the
		NSH ELF program is installed.

endif
```

## apps/ara/svc/Kconfig
```kconfig
#
# For a description of the syntax of this configuration file,
# see misc/tools/kconfig-language.txt.
#
# Copyright (C) 2014 Google, Inc.
#

config ARA_SVC_MAIN
	bool "Ara SVC main"
	default n
	---help---
		Enable the Ara SVC main program

if ARA_SVC_MAIN

config ARA_SVC_MAIN_PROGNAME
	string "Program name"
	default "svc"
	depends on BUILD_KERNEL
	---help---
		This is the name of the program that will be use when the NSH ELF
		program is installed.

endif
```

## apps/ara/svc_power/Kconfig
```kconfig
#
# For a description of the syntax of this configuration file,
# see misc/tools/kconfig-language.txt.
#
# Copyright (c) 2014 Google, Inc.
# Google Confidential/Restricted
#

config ARA_SVC_POWER
	bool "Ara SVC Power control"
	default n
	depends on ARCH_BOARD_ARA_ENDO_SVC || ARCH_BOARD_ARA_SVC
	---help---
		Enable the Ara Power program. Controls the interfaces power
                supply and wakeout signal

if ARA_SVC_POWER

config ARA_SVC_POWER_PROGNAME
	string "Program name"
	default "power"
	depends on BUILD_KERNEL
	---help---
		This is the name of the program that will be use when the NSH ELF
		program is installed.

endif
```

## apps/ara/tca/Kconfig
```kconfig
#
# For a description of the syntax of this configuration file,
# see misc/tools/kconfig-language.txt.
#

config ARA_TCA_MAIN
	bool "Ara TCA6408 main"
	default y
	depends on ARCH_CHIP_TSB
	---help---
		Enable the Ara TCA6408 (GPIO expander) test program

if ARA_TCA_MAIN

config ARA_TCA_MAIN_PROGNAME
	string "Program name"
	default "tca"
	depends on BUILD_KERNEL
	---help---
		This is the name of the program that will be use when the NSH ELF
		program is installed.

endif
```

## apps/ara/time/Kconfig
```kconfig
#
# For a description of the syntax of this configuration file,
# see misc/tools/kconfig-language.txt.
#

config ARA_TIME
	bool "Display current time"
	default n
	---help---
		Display current time using toshiba high resolution timer
		in various formats.
```

## apps/ara/unipro/Kconfig
```kconfig
#
# For a description of the syntax of this configuration file,
# see misc/tools/kconfig-language.txt.
#

config ARA_UNIPRO_MAIN
	bool "Ara UNIPRO main"
	default n
	depends on ARCH_CHIP_TSB
	---help---
		Enable the Ara UNIPRO main programz

if ARA_UNIPRO_MAIN

config ARA_UNIPRO_MAIN_PROGNAME
	string "Program name"
	default "unipro"
	depends on BUILD_KERNEL
	---help---
		This is the name of the program that will be use when the
		NSH ELF program is installed.

endif
```

## apps/examples/Kconfig
```kconfig
#
# Copyright (c) 2015 Google, Inc.
# All rights reserved.
#
# Redistribution and use in source and binary forms, with or without
# modification, are permitted provided that the following conditions are met:
# 1. Redistributions of source code must retain the above copyright notice,
# this list of conditions and the following disclaimer.
# 2. Redistributions in binary form must reproduce the above copyright notice,
# this list of conditions and the following disclaimer in the documentation
# and/or other materials provided with the distribution.
# 3. Neither the name of the copyright holder nor the names of its
# contributors may be used to endorse or promote products derived from this
# software without specific prior written permission.
#
# THIS SOFTWARE IS PROVIDED BY THE COPYRIGHT HOLDERS AND CONTRIBUTORS "AS IS"
# AND ANY EXPRESS OR IMPLIED WARRANTIES, INCLUDING, BUT NOT LIMITED TO,
# THE IMPLIED WARRANTIES OF MERCHANTABILITY AND FITNESS FOR A PARTICULAR
# PURPOSE ARE DISCLAIMED. IN NO EVENT SHALL THE COPYRIGHT HOLDER OR
# CONTRIBUTORS BE LIABLE FOR ANY DIRECT, INDIRECT, INCIDENTAL, SPECIAL,
# EXEMPLARY, OR CONSEQUENTIAL DAMAGES (INCLUDING, BUT NOT LIMITED TO,
# PROCUREMENT OF SUBSTITUTE GOODS OR SERVICES; LOSS OF USE, DATA, OR PROFITS;
# OR BUSINESS INTERRUPTION) HOWEVER CAUSED AND ON ANY THEORY OF LIABILITY,
# WHETHER IN CONTRACT, STRICT LIABILITY, OR TORT (INCLUDING NEGLIGENCE OR
# OTHERWISE) ARISING IN ANY WAY OUT OF THE USE OF THIS SOFTWARE, EVEN IF
# ADVISED OF THE POSSIBILITY OF SUCH DAMAGE.
#
# For a description of the syntax of this configuration file,
# see misc/tools/kconfig-language.txt.
#

source "$APPSDIR/examples/adc/Kconfig"
source "$APPSDIR/examples/battery_state/Kconfig"
source "$APPSDIR/examples/bq24292/Kconfig"
source "$APPSDIR/examples/bq25896/Kconfig"
source "$APPSDIR/examples/buttons/Kconfig"
source "$APPSDIR/examples/can/Kconfig"
source "$APPSDIR/examples/cc3000/Kconfig"
source "$APPSDIR/examples/configdata/Kconfig"
source "$APPSDIR/examples/cpuhog/Kconfig"
source "$APPSDIR/examples/cxxtest/Kconfig"
source "$APPSDIR/examples/dhcpd/Kconfig"
source "$APPSDIR/examples/elf/Kconfig"
source "$APPSDIR/examples/ftpc/Kconfig"
source "$APPSDIR/examples/ftpd/Kconfig"
source "$APPSDIR/examples/hello/Kconfig"
source "$APPSDIR/examples/helloxx/Kconfig"
source "$APPSDIR/examples/json/Kconfig"
source "$APPSDIR/examples/hidkbd/Kconfig"
source "$APPSDIR/examples/keypadtest/Kconfig"
source "$APPSDIR/examples/igmp/Kconfig"
source "$APPSDIR/examples/i2schar/Kconfig"
source "$APPSDIR/examples/lcdrw/Kconfig"
source "$APPSDIR/examples/mm/Kconfig"
source "$APPSDIR/examples/mount/Kconfig"
source "$APPSDIR/examples/mtdpart/Kconfig"
source "$APPSDIR/examples/mtdrwb/Kconfig"
source "$APPSDIR/examples/netpkt/Kconfig"
source "$APPSDIR/examples/nettest/Kconfig"
source "$APPSDIR/examples/nrf24l01_term/Kconfig"
source "$APPSDIR/examples/nsh/Kconfig"
source "$APPSDIR/examples/null/Kconfig"
source "$APPSDIR/examples/nx/Kconfig"
source "$APPSDIR/examples/nxterm/Kconfig"
source "$APPSDIR/examples/nxffs/Kconfig"
source "$APPSDIR/examples/nxflat/Kconfig"
source "$APPSDIR/examples/nxhello/Kconfig"
source "$APPSDIR/examples/nximage/Kconfig"
source "$APPSDIR/examples/nxlines/Kconfig"
source "$APPSDIR/examples/nxtext/Kconfig"
source "$APPSDIR/examples/ostest/Kconfig"
source "$APPSDIR/examples/pashello/Kconfig"
source "$APPSDIR/examples/pipe/Kconfig"
source "$APPSDIR/examples/poll/Kconfig"
source "$APPSDIR/examples/pwm/Kconfig"
source "$APPSDIR/examples/posix_spawn/Kconfig"
source "$APPSDIR/examples/qencoder/Kconfig"
source "$APPSDIR/examples/random/Kconfig"
source "$APPSDIR/examples/relays/Kconfig"
source "$APPSDIR/examples/rgmp/Kconfig"
source "$APPSDIR/examples/romfs/Kconfig"
source "$APPSDIR/examples/sendmail/Kconfig"
source "$APPSDIR/examples/serialblaster/Kconfig"
source "$APPSDIR/examples/serialrx/Kconfig"
source "$APPSDIR/examples/serloop/Kconfig"
source "$APPSDIR/examples/slcd/Kconfig"
source "$APPSDIR/examples/flash_test/Kconfig"
source "$APPSDIR/examples/smart_test/Kconfig"
source "$APPSDIR/examples/smart/Kconfig"
source "$APPSDIR/examples/tcpecho/Kconfig"
source "$APPSDIR/examples/telnetd/Kconfig"
source "$APPSDIR/examples/thttpd/Kconfig"
source "$APPSDIR/examples/tiff/Kconfig"
source "$APPSDIR/examples/touchscreen/Kconfig"
source "$APPSDIR/examples/udp/Kconfig"
source "$APPSDIR/examples/discover/Kconfig"
source "$APPSDIR/examples/webserver/Kconfig"
source "$APPSDIR/examples/usbserial/Kconfig"
source "$APPSDIR/examples/usbterm/Kconfig"
source "$APPSDIR/examples/watchdog/Kconfig"
source "$APPSDIR/examples/wget/Kconfig"
source "$APPSDIR/examples/wgetjson/Kconfig"
source "$APPSDIR/examples/xmlrpc/Kconfig"
source "$APPSDIR/examples/version/Kconfig"
```

## apps/greybus-utils/Kconfig
```kconfig
#
# Copyright (c) 2015 Google, Inc.
# All rights reserved.
#
# Redistribution and use in source and binary forms, with or without
# modification, are permitted provided that the following conditions are met:
# 1. Redistributions of source code must retain the above copyright notice,
# this list of conditions and the following disclaimer.
# 2. Redistributions in binary form must reproduce the above copyright notice,
# this list of conditions and the following disclaimer in the documentation
# and/or other materials provided with the distribution.
# 3. Neither the name of the copyright holder nor the names of its
# contributors may be used to endorse or promote products derived from this
# software without specific prior written permission.
#
# THIS SOFTWARE IS PROVIDED BY THE COPYRIGHT HOLDERS AND CONTRIBUTORS "AS IS"
# AND ANY EXPRESS OR IMPLIED WARRANTIES, INCLUDING, BUT NOT LIMITED TO,
# THE IMPLIED WARRANTIES OF MERCHANTABILITY AND FITNESS FOR A PARTICULAR
# PURPOSE ARE DISCLAIMED. IN NO EVENT SHALL THE COPYRIGHT HOLDER OR
# CONTRIBUTORS BE LIABLE FOR ANY DIRECT, INDIRECT, INCIDENTAL, SPECIAL,
# EXEMPLARY, OR CONSEQUENTIAL DAMAGES (INCLUDING, BUT NOT LIMITED TO,
# PROCUREMENT OF SUBSTITUTE GOODS OR SERVICES; LOSS OF USE, DATA, OR PROFITS;
# OR BUSINESS INTERRUPTION) HOWEVER CAUSED AND ON ANY THEORY OF LIABILITY,
# WHETHER IN CONTRACT, STRICT LIABILITY, OR TORT (INCLUDING NEGLIGENCE OR
# OTHERWISE) ARISING IN ANY WAY OUT OF THE USE OF THIS SOFTWARE, EVEN IF
# ADVISED OF THE POSSIBILITY OF SUCH DAMAGE.
#
# For a description of the syntax of this configuration file,
# see misc/tools/kconfig-language.txt.
#

config GREYBUS_DEBUG
	bool "Enable Greybus log"

choice
	prompt "Select Greybus log level"
	depends on GREYBUS_DEBUG
config GB_LOG_INFO
	bool "info"
config GB_LOG_WARNING
	bool "warning, errors and info"
config GB_LOG_DEBUG
	bool "debug, warning, errors and info"
config GB_LOG_DUMP
	bool "dump data, warning, errors and info"
endchoice

choice
	prompt "Greybus log format"
	depends on GREYBUS_DEBUG
config GB_LOG_LEVEL
	bool "append log level"
config GB_LOG_FILE
	bool "append file and line"
config GB_LOG_FUNC
	bool "append function name"
endchoice

choice
	prompt "Select a predefined Manifest"
config MANIFEST_ALL
	bool "All Protocols"
config CUSTOM_MANIFEST
	bool "Custom manifest"
config OOT_MANIFEST
	bool "Out-of-tree manifest"
	---help---
		With this choice, the manifest in OOT_MANIFEST will be compiled and
		linked to the in-tree object files.
endchoice

config MANIFEST
	string "manifest name"
	depends on CUSTOM_MANIFEST
```

## apps/mods/Kconfig
```kconfig
#
# For a description of the syntax of this configuration file,
# see misc/tools/kconfig-language.txt.
#

source "$APPSDIR/mods/diet/Kconfig"
source "$APPSDIR/mods/mhb_client/Kconfig"
source "$APPSDIR/mods/mhb_server/Kconfig"
source "$APPSDIR/mods/raw/Kconfig"
source "$APPSDIR/mods/spi_reg/Kconfig"
source "$APPSDIR/mods/usbtun/Kconfig"
source "$APPSDIR/mods/hsic_test/Kconfig"
```

## apps/mods/diet/Kconfig
```kconfig
#
# For a description of the syntax of this configuration file,
# see misc/tools/kconfig-language.txt.
#

config MODS_DIET
	bool "Diet Mods"
	select GREYBUS_UTILS
	default n

config MODS_USER_INIT
	bool "Initialize device drivers when app starts"
	default n
	depends on MODS_DIET
```

## apps/mods/hsic_test/Kconfig
```kconfig
#
# For a description of the syntax of this configuration file,
# see misc/tools/kconfig-language.txt.
#

config MODS_HSIC_TEST
	bool "Enable HSIC Test Interface"
	default n
	depends on ARCH_CHIP_USB_PCD
	---help---
		Enable HSIC Test Interface at start up.
```
