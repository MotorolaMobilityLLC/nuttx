## apps/mods/mhb_client/Kconfig
```kconfig
#
# For a description of the syntax of this configuration file,
# see misc/tools/kconfig-language.txt.
#

config MODS_MHB_CLIENT
	bool "Mods MHB Client"
	default n
	depends on MHB
	depends on NSH_CONSOLE
	---help---
		Enable the Mods MHB Client for debugging

if MODS_MHB_CLIENT
config MODS_MHB_CLIENT_PROGNAME
	string "Program name"
	default "apbe"
	---help---
		Name of the MHB client app.

endif
```

## apps/mods/mhb_server/Kconfig
```kconfig
#
# For a description of the syntax of this configuration file,
# see misc/tools/kconfig-language.txt.
#

config MODS_MHB_SERVER
	bool "Mods MHB Server"
	default n
	depends on ARCH_CHIP_TSB
	depends on MHB
	---help---
		Enable the Mods MHB Server
```

## apps/mods/raw/Kconfig
```kconfig
#
# For a description of the syntax of this configuration file,
# see misc/tools/kconfig-language.txt.
#

config MODS_RAW
	bool "Mods Raw"
	default n
	---help---
		Send Raw Data

if MODS_RAW

config MODS_RAW_PROGNAME
	string "Program name"
	default "raw"
	depends on BUILD_KERNEL
	---help---
		This is the name of the program that will be use when the NSH ELF
		program is installed.

endif
```

## apps/mods/spi_reg/Kconfig
```kconfig
#
# For a description of the syntax of this configuration file,
# see misc/tools/kconfig-language.txt.
#

config MODS_SPI_REG
	bool "Mods SPI Reg"
	depends on SPI_SLAVE
	default n
	---help---
		Enable the Mods Register Based Slave

if MODS_SPI_REG

config MODS_SPI_REG_PROGNAME
	string "Program name"
	default "mods_spi_reg"
	depends on BUILD_KERNEL
	---help---
		This is the name of the program that will be use when the NSH ELF
		program is installed.

config MODS_SPI_REG_BUS
	int "SPI Bus Number"
	default 1
	---help---
		SPI bus to use for slave device (default 1).

endif
```

## apps/mods/usb_ext/Kconfig
```kconfig
#
# For a description of the syntax of this configuration file,
# see misc/tools/kconfig-language.txt.
#

config MODS_USB_EXT_TEST
	bool "Mods USB_EXT Test APP"
	default n

if MODS_USB_EXT_TEST

config MODS_USB_EXT_TEST_MAIN
	string "Program name"
	default "usb_ext_main"
	depends on BUILD_KERNEL

endif
```

## apps/mods/usbtun/Kconfig
```kconfig
#
# For a description of the syntax of this configuration file,
# see misc/tools/kconfig-language.txt.
#

config MODS_USB_HCD_ROUTER
	bool "USB tunneling over HSIC @ Host"
	default n
	depends on ARCH_CHIP_USB_HCD
	---help---
		Enable the Mods USB tunneling at HSIC Host

config MODS_USB_PCD_ROUTER
	bool "USB tunneling over HSIC @ Device"
	default n
	depends on ARCH_CHIP_USB_PCD
	---help---
		Enable the Mods USB tunneling at HSIC Device

config MODS_USBTUN_CPORT_ID
	int "CPORT ID used for USB tunneling"
	default 13
	depends on ARCH_CHIP_USB_HCD || ARCH_CHIP_USB_PCD

config MODS_USB_HCD_TUN_PORT
	int "USB Hub port to be tunneled"
	default 1
	depends on MODS_USB_HCD_ROUTER
	---help---
		Hub port number USB traffic to be tunneled
```

## apps/netutils/Kconfig
```kconfig
#
# For a description of the syntax of this configuration file,
# see misc/tools/kconfig-language.txt.
#

comment "Networking Utilities"

source "$APPSDIR/netutils/json/Kconfig"
```

## apps/slice/Kconfig
```kconfig
#
# For a description of the syntax of this configuration file,
# see misc/tools/kconfig-language.txt.
#

source "$APPSDIR/slice/cmd/Kconfig"
source "$APPSDIR/slice/spi_reg/Kconfig"
```

## apps/slice/cmd/Kconfig
```kconfig
#
# For a description of the syntax of this configuration file,
# see misc/tools/kconfig-language.txt.
#

config SLICE_CMD
	bool "Slice CMD"
	default n
	select I2C_SLAVE
	---help---
		Enable the Slice command handler

if SLICE_CMD

config SLICE_CMD_I2C_SLAVE_BUS
	int "I2C Slave Bus Number"
	default 1
	depends on SLICE_CMD
	---help---
		I2C bus to use for slave device (default 1).

config SLICE_CMD_I2C_SLAVE_ADDR
	hex "I2C Slave Address"
	depends on SLICE_CMD
	default 0x55
	---help---
		I2C slave 7-bit device address (default: 0x55)

config SLICE_CMD_I2C_SEC_SLAVE_ADDR
	hex "I2C Secondary Slave Address"
	depends on SLICE_CMD
	depends on I2C_SLAVE_SECONDARY
	default 0x39
	---help---
		I2C secondary slave 7-bit device address (default: 0x39)

endif
```

## apps/slice/diet/Kconfig
```kconfig
#
# For a description of the syntax of this configuration file,
# see misc/tools/kconfig-language.txt.
#

config SLICE_DIET
	bool "Diet Slice"
	select GREYBUS_UTILS
	default n
```

## apps/slice/spi_reg/Kconfig
```kconfig
#
# For a description of the syntax of this configuration file,
# see misc/tools/kconfig-language.txt.
#

config SLICE_SPI_REG
	bool "Slice SPI Reg"
	depends on SPI_SLAVE
	default n
	---help---
		Enable the Slice Register Based Slave

if SLICE_SPI_REG

config SLICE_SPI_REG_PROGNAME
	string "Program name"
	default "slice_spi_reg"
	depends on BUILD_KERNEL
	---help---
		This is the name of the program that will be use when the NSH ELF
		program is installed.

config SLICE_SPI_REG_BUS
	int "SPI Bus Number"
	default 1
	---help---
		SPI bus to use for slave device (default 1).

endif
```

## apps/system/adc/Kconfig
```kconfig
config SYSTEM_ADCTOOL
	bool "ADC tool"
	default n
	depends on ADC
	---help---
		Enable support for the ADC tool.

if SYSTEM_ADCTOOL
config ADCTOOL_APP_PROGNAME
	string "Program name"
	default "adc"
	---help---
		Name of the app.
endif
```

## nuttx/arch/arm/Kconfig
```kconfig
#
# Copyright (c) 2014-2015 Google, Inc.
# All rights reserved.
#
# Redistribution and use in source and binary forms, with or without
# modification, are permitted provided that the following conditions are met:
# 1. Redistributions of source code must retain the above copyright notice,
# this list of conditions and the following disclaimer.
# 2. Redistributions in binary form must reproduce the above copyright notice,
# this list of conditions and the following disclaimer in the documentation
# and/or other materials provided with the distribution.
# 3. Neither the name of the copyright holder nor the names of its
# contributors may be used to endorse or promote products derived from this
# software without specific prior written permission.
#
# THIS SOFTWARE IS PROVIDED BY THE COPYRIGHT HOLDERS AND CONTRIBUTORS "AS IS"
# AND ANY EXPRESS OR IMPLIED WARRANTIES, INCLUDING, BUT NOT LIMITED TO,
# THE IMPLIED WARRANTIES OF MERCHANTABILITY AND FITNESS FOR A PARTICULAR
# PURPOSE ARE DISCLAIMED. IN NO EVENT SHALL THE COPYRIGHT HOLDER OR
# CONTRIBUTORS BE LIABLE FOR ANY DIRECT, INDIRECT, INCIDENTAL, SPECIAL,
# EXEMPLARY, OR CONSEQUENTIAL DAMAGES (INCLUDING, BUT NOT LIMITED TO,
# PROCUREMENT OF SUBSTITUTE GOODS OR SERVICES; LOSS OF USE, DATA, OR PROFITS;
# OR BUSINESS INTERRUPTION) HOWEVER CAUSED AND ON ANY THEORY OF LIABILITY,
# WHETHER IN CONTRACT, STRICT LIABILITY, OR TORT (INCLUDING NEGLIGENCE OR
# OTHERWISE) ARISING IN ANY WAY OUT OF THE USE OF THIS SOFTWARE, EVEN IF
# ADVISED OF THE POSSIBILITY OF SUCH DAMAGE.
#
# For a description of the syntax of this configuration file,
# see misc/tools/kconfig-language.txt.
#

if ARCH_ARM

choice
	prompt "Select Desired ARM chip"
	default ARCH_CHIP_STM32

config ARCH_CHIP_STM32
	bool "STMicro STM32"
	select ARCH_HAVE_CMNVECTOR
	select ARCH_HAVE_MPU
        select ARCH_HAVE_FPU
        select ARCH_CORTEXM4
	select ARCH_HAVE_I2CRESET
	select ARCH_HAVE_HEAPCHECK
	select ARCH_HAVE_HIRES_TIMER
	---help---
		STMicro STM32 architectures (ARM Cortex-M3/4).

config ARCH_CHIP_TSB
	bool "Toshiba Bridge"
	select ARCH_CORTEXM3
	select ARCH_HAVE_CMNVECTOR
	select ARCH_HAVE_HIRES_TIMER
	select MM_BUFRAM_ALLOCATOR
	select ARCH_HAVE_TICKLESS
	select ARCH_HAVE_UID
	select ARCH_HAVE_CHIPID
	select ARCH_HAVE_BOARDID
	---help---
		Toshiba Bridge architectures (ARM Cortex-M3).

endchoice

config ARCH_CORTEXM3
	bool
	default n
	select ARCH_HAVE_IRQPRIO
	select ARCH_HAVE_RAMVECTORS
	select ARCH_HAVE_HIPRI_INTERRUPT
	select ARCH_HAVE_SYSRESET

config ARCH_CORTEXM4
	bool
	default n
	select ARCH_HAVE_IRQPRIO
	select ARCH_HAVE_RAMVECTORS
	select ARCH_HAVE_HIPRI_INTERRUPT
	select ARCH_HAVE_SYSRESET

config ARCH_FAMILY
	string
	default "armv7-m"	if ARCH_CORTEXM3 || ARCH_CORTEXM4

config ARCH_CHIP
	string
	default "stm32"		if ARCH_CHIP_STM32
	default "tsb"		if ARCH_CHIP_TSB

if ARCH_CHIP_STM32
source arch/arm/src/stm32/Kconfig
endif
if ARCH_CHIP_TSB
source arch/arm/src/tsb/Kconfig
endif
if ARCH_CORTEXM3 || ARCH_CORTEXM4
source arch/arm/src/armv7-m/Kconfig
endif

config ARMV7M_USEBASEPRI
	bool "Use BASEPRI Register"
	default n
	depends on ARCH_CORTEXM3 || ARCH_CORTEXM4
	---help---
		Use the BASEPRI register to enable and disable interrupts. By
		default, the PRIMASK register is used for this purpose. This
		usually results in hardfaults when supervisor calls are made.
		Though, these hardfaults are properly handled by the RTOS, the
		hardfaults can confuse some debuggers. With the BASEPRI
		register, these hardfaults, will be avoided. For more details see
		http://www.nuttx.org/doku.php?id=wiki:nxinternal:svcall

config ARCH_HAVE_CMNVECTOR
        bool 
	default n

config ARMV7M_CMNVECTOR
	bool "Use common ARMv7-M vectors"
	default n
	depends on ARCH_HAVE_CMNVECTOR
	---help---
		Some architectures use their own, built-in vector logic.  Some use only
		the common vector logic.  Some can use either their own built-in vector
		logic or the common vector logic.  This applies only to ARMv7-M
		architectures.

config ARCH_HAVE_FPU
        bool 
	default y

config ARCH_FPU
        bool
	default y

config ARMV7M_MPU
        bool 
	default y

config ARMV7M_MPU_NREGIONS
	int "Number of MPU regions"
	default 8
	depends on ARMV7M_MPU
	---help---
		This is the number of protection regions supported by the MPU.

config ARCH_HAVE_LOWVECTORS
	bool

config ARCH_LOWVECTORS
	bool "Vectors in low memory"
	default n
	depends on ARCH_HAVE_LOWVECTORS
	---help---
		Support ARM vectors in low memory.

config ARCH_ROMPGTABLE
	bool "ROM page table"
	default n
	depends on ARCH_USE_MMU
	---help---
		Support a fixed memory mapping use a (read-only) page table in ROM/FLASH.

config DEBUG_HARDFAULT
	bool "Verbose Hard-Fault Debug"
	default n
	depends on DEBUG && (ARCH_CORTEXM3 || ARCH_CORTEXM4)
	---help---
		Enables verbose debug output when a hard fault is occurs.  This verbose
		output is sometimes helpful when debugging difficult hard fault problems,
		but may be more than you typcially want to see.

config ARM_SEMIHOSTING
	bool "ARM Semihosting"
	default n

config ARCH_HAVE_HIRES_TIMER
	bool
	default n

endif
```
