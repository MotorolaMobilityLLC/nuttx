## nuttx/drivers/i2s_tunnel/Kconfig
```kconfig
#
# Copyright (c) 2016 Motorola Mobility, LLC
# All rights reserved.
#
# Redistribution and use in source and binary forms, with or without
# modification, are permitted provided that the following conditions are met:
# 1. Redistributions of source code must retain the above copyright notice,
# this list of conditions and the following disclaimer.
# 2. Redistributions in binary form must reproduce the above copyright notice,
# this list of conditions and the following disclaimer in the documentation
# and/or other materials provided with the distribution.
# 3. Neither the name of the copyright holder nor the names of its
# contributors may be used to endorse or promote products derived from this
# software without specific prior written permission.
#
# THIS SOFTWARE IS PROVIDED BY THE COPYRIGHT HOLDERS AND CONTRIBUTORS "AS IS"
# AND ANY EXPRESS OR IMPLIED WARRANTIES, INCLUDING, BUT NOT LIMITED TO,
# THE IMPLIED WARRANTIES OF MERCHANTABILITY AND FITNESS FOR A PARTICULAR
# PURPOSE ARE DISCLAIMED. IN NO EVENT SHALL THE COPYRIGHT HOLDER OR
# CONTRIBUTORS BE LIABLE FOR ANY DIRECT, INDIRECT, INCIDENTAL, SPECIAL,
# EXEMPLARY, OR CONSEQUENTIAL DAMAGES (INCLUDING, BUT NOT LIMITED TO,
# PROCUREMENT OF SUBSTITUTE GOODS OR SERVICES; LOSS OF USE, DATA, OR PROFITS;
# OR BUSINESS INTERRUPTION) HOWEVER CAUSED AND ON ANY THEORY OF LIABILITY,
# WHETHER IN CONTRACT, STRICT LIABILITY, OR TORT (INCLUDING NEGLIGENCE OR
# OTHERWISE) ARISING IN ANY WAY OUT OF THE USE OF THIS SOFTWARE, EVEN IF
# ADVISED OF THE POSSIBILITY OF SUCH DAMAGE.
#
# For a description of the syntax of this configuration file,
# see misc/tools/kconfig-language.txt.
#

config I2S_TUNNEL
	bool "Enable I2S tunneling device driver support."
	default n

if I2S_TUNNEL

choice
	prompt "Select an I2S tunnel mode"

config I2S_TUNNEL_LOCAL_LOOPBACK
	bool "Define this if local loopback testing is desired."
	---help---
		Local loopback testing enables a single device to loopback on I2S to itself.
		To use this mode the TX and RX data lines must be shorted.  No transport is
		used in this configuration.  It can be used for testing DMA as well as the
		I2S hardware block.

config I2S_TUNNEL_ROUNDTRIP_LOOPBACK
	bool "Define this if I2S loopback over the transport testing is desired."
	---help---
		In this mode the APBA sends I2S data out it's I2S bus in master mode, then
		receives the data it sent.  The received data is then sent over the transport
		(currently Unipro) to the APBE.  The APBE in turn sends the data out it's
		I2S bus in master mode.  The data the APBE receives is then send back to
		the APBA and the cycle continues.  This is useful for testing the round
		trip performance of the system.  For this to work the APBA RX and TX
		lines must be shorted and the APBE RX and TX lines must be shorted.

endchoice


endif
```

## nuttx/drivers/mhb/Kconfig
```kconfig
############################################################################
#
#   Copyright (c) 2016 Motorola Mobility, LLC.
#   All rights reserved.
#
# Redistribution and use in source and binary forms, with or without
# modification, are permitted provided that the following conditions
# are met:
#
# 1. Redistributions of source code must retain the above copyright
#    notice, this list of conditions and the following disclaimer.
# 2. Redistributions in binary form must reproduce the above copyright
#    notice, this list of conditions and the following disclaimer in
#    the documentation and/or other materials provided with the
#    distribution.
# 3. Neither the name NuttX nor the names of its contributors may be
#    used to endorse or promote products derived from this software
#    without specific prior written permission.
#
# THIS SOFTWARE IS PROVIDED BY THE COPYRIGHT HOLDERS AND CONTRIBUTORS
# "AS IS" AND ANY EXPRESS OR IMPLIED WARRANTIES, INCLUDING, BUT NOT
# LIMITED TO, THE IMPLIED WARRANTIES OF MERCHANTABILITY AND FITNESS
# FOR A PARTICULAR PURPOSE ARE DISCLAIMED. IN NO EVENT SHALL THE
# COPYRIGHT OWNER OR CONTRIBUTORS BE LIABLE FOR ANY DIRECT, INDIRECT,
# INCIDENTAL, SPECIAL, EXEMPLARY, OR CONSEQUENTIAL DAMAGES (INCLUDING,
# BUT NOT LIMITED TO, PROCUREMENT OF SUBSTITUTE GOODS OR SERVICES; LOSS
# OF USE, DATA, OR PROFITS; OR BUSINESS INTERRUPTION) HOWEVER CAUSED
# AND ON ANY THEORY OF LIABILITY, WHETHER IN CONTRACT, STRICT
# LIABILITY, OR TORT (INCLUDING NEGLIGENCE OR OTHERWISE) ARISING IN
# ANY WAY OUT OF THE USE OF THIS SOFTWARE, EVEN IF ADVISED OF THE
# POSSIBILITY OF SUCH DAMAGE.
#
############################################################################

config MHB_APBE_CTRL_DEVICE
	bool "APBE control device"
	default n
	depends on MHB
	depends on GREYBUS_MODS
	select DEVICE_CORE

config MHB_UART
	bool "MHB UART Transport"
	default n
	depends on MHB
	---help---
		This selection enables the UART transport for the MHB.

if MHB_UART
config MHB_UART_BAUD
	int "MHB UART0 BAUD"
	default 115200
	---help---
		MHB UART baud rate.  Default: 115200

config MHB_UART_RXBUFSIZE
	int "MHB UART Rx buffer size"
	default 2048
	---help---
		MHB UART Rx buffer size.  Default: 2048

config MHB_UART_TXBUFSIZE
	int "MHB UART Tx buffer size"
	default 2048
	---help---
		MHB UART Tx buffer size.  Default: 2048

config MHB_UART_FLOWCONTROL
	bool "MHB UART CTS/RTS flow control"
	default y
	---help---
		Enable MHB UART CTS/RTS flow control

config MHB_UART_WAIT_FOR_SYNC
	bool "MHB UART Wait for Sync"
	default n
	---help---
		Wait for a sync pattern on start-up.

config MHB_UART_SEND_SYNC
	bool "MHB UART Send Sync"
	default n
	---help---
		Send a sync pattern on start-up.
endif

config MHB_DSI_DISPLAY
	bool "MHB DSI Display"
	default n
	---help---
		DSI display driven by an MHB server.

config MHB_CAMERA
	bool "MHB Camera"
	default n
	depends on GREYBUS_CAMERA_EXT
	---help---
		GB CAMERA_EXT based camera driven by an MHB server.

if MHB_CAMERA
source drivers/camera/Kconfig
endif

config MHB_CAMERA_I2C_BUS_ID
	int "Camera I2C Bus ID"
	default 0
	depends on MHB_CAMERA

config MHB_CAMERA_I2C_RETRY
        int "Camera I2C txn retry attempts"
        default 5
        depends on MHB_CAMERA

config MHB_CAMERA_I2C_RETRY_DELAY_US
        int "Camera I2C delay between retries"
        default 10000
        depends on MHB_CAMERA

config MHB_CAMERA_OFF_DELAY_MS
	int "Delay (ms) before camera powerdown"
	default 100
	depends on MHB_CAMERA

config MHB_I2S_AUDIO
	bool "MHB I2S Audio"
	default n
	---help---
		I2S Audio driven by an MHB server.

config MHB_USBTUN
	bool "MHB USB Tunneling"
	default n
	---help---
		USB tunnel over HSIC driven by an MHB server.

config MHB_IPC
	bool "MHB IPC"
	default n
	depends on ARCH_CHIP_TSB
	---help---
		Enable the MHB IPC interface.

if MHB_IPC
source drivers/mhb/ipc/Kconfig
endif
```

## nuttx/drivers/mhb/ipc/Kconfig
```kconfig
config MHB_IPC_CLIENT
	bool "MHB IPC Client"
	default n
	depends on ARCH_CHIP_TSB
	---help---
		Enable the IPC client interface.

config MHB_IPC_SERVER
	bool "MHB IPC Server"
	default n
	depends on ARCH_CHIP_TSB
	---help---
		Enable the IPC server interface.

if MHB_IPC_CLIENT || MHB_IPC_SERVER
config MHB_IPC_CPORT_ID
	int "MHB IPC cport"
	default 15
	---help---
		MHB IPC cport.  Default: 15
endif
```
