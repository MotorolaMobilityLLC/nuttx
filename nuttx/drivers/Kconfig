## nuttx/drivers/backlight/Kconfig
```kconfig
# For a description of the syntax of this configuration file,
# see misc/tools/kconfig-language.txt.
#
config BACKLIGHT_DCS
	bool "DCS support"
	default n
	---help---
		DCS backlight driver.

config BACKLIGHT_ISL98611
	bool "Intersil ISL98611 support"
	default n
	select I2C
	---help---
		Intersil ISL98611 backlight driver.

if BACKLIGHT_ISL98611
config BACKLIGHT_ISL98611_I2C_BUS
	int "ISL98611 I2C bus"
	default 3
	---help---
		ISL98611 I2C bus.  Default: 3

config BACKLIGHT_ISL98611_I2C_ADDR
	hex "ISL98611 I2C address"
	default 0x29
	---help---
		ISL98611 I2C address.  Default: 0x29
endif

config BACKLIGHT_LM27965
	bool "Intersil LM27965 support"
	default n
	select I2C
	---help---
		Intersil LM27965 backlight driver.

if BACKLIGHT_LM27965
config BACKLIGHT_LM27965_I2C_BUS
	int "LM27965 I2C bus"
	default 3
	---help---
		LM27965 I2C bus.  Default: 3

config BACKLIGHT_LM27965_I2C_ADDR
	hex "LM27965 I2C address"
	default 0x36
	---help---
		LM27965 I2C address.  Default: 0x36  Alternative: 0x38
endif
```

## nuttx/drivers/display/Kconfig
```kconfig
# For a description of the syntax of this configuration file,
# see misc/tools/kconfig-language.txt.
#
config DISPLAY_ANX7750
	bool "Analogix 7750 support"
	default n
	select I2C
	---help---
		ANX7750 is SlimPort to DisplayPort Converter
		for video stream up to 4K@30Hz.

config DISPLAY_NT35355_360P
	bool "NT 35355, 360p DSI display panel support"
	default n
	depends on MHB_DSI_DISPLAY
	---help---
		Support for a NT 35355, 360p DSI display panel connected
		via Mods High-Speed Bus (MHB).

config DISPLAY_TDI_546_1080P
	bool "TDI 5.46 inch, 1080p DSI display panel support"
	default n
	depends on MHB_DSI_DISPLAY
	---help---
		Support for a TDI 5.46 inch, 1080p DSI display panel connected
		via Mods High-Speed Bus (MHB).

config DISPLAY_SMD_470_720P
	bool "SMD 4.70 inch, 720p DSI display panel support"
	default n
	depends on MHB_DSI_DISPLAY
	---help---
		Support for a SMD 4.70 inch, 720p DSI display panel connected
		via Mods High-Speed Bus (MHB).
```

## nuttx/drivers/gpio/Kconfig
```kconfig
#
# Copyright (c) 2014-2015 Google Inc.
# Based on Gregory Nutt <gnutt@nuttx.org> sensors Kconfig
#
# For a description of the syntax of this configuration file,
# see misc/tools/kconfig-language.txt.
#

config GPIO_TCA6408
    bool "TCA6408 device support"
    default n
```

## nuttx/drivers/greybus/Kconfig
```kconfig
#
# Copyright (c) 2015 Google, Inc.
# All rights reserved.
#
# Redistribution and use in source and binary forms, with or without
# modification, are permitted provided that the following conditions are met:
# 1. Redistributions of source code must retain the above copyright notice,
# this list of conditions and the following disclaimer.
# 2. Redistributions in binary form must reproduce the above copyright notice,
# this list of conditions and the following disclaimer in the documentation
# and/or other materials provided with the distribution.
# 3. Neither the name of the copyright holder nor the names of its
# contributors may be used to endorse or promote products derived from this
# software without specific prior written permission.
#
# THIS SOFTWARE IS PROVIDED BY THE COPYRIGHT HOLDERS AND CONTRIBUTORS "AS IS"
# AND ANY EXPRESS OR IMPLIED WARRANTIES, INCLUDING, BUT NOT LIMITED TO,
# THE IMPLIED WARRANTIES OF MERCHANTABILITY AND FITNESS FOR A PARTICULAR
# PURPOSE ARE DISCLAIMED. IN NO EVENT SHALL THE COPYRIGHT HOLDER OR
# CONTRIBUTORS BE LIABLE FOR ANY DIRECT, INDIRECT, INCIDENTAL, SPECIAL,
# EXEMPLARY, OR CONSEQUENTIAL DAMAGES (INCLUDING, BUT NOT LIMITED TO,
# PROCUREMENT OF SUBSTITUTE GOODS OR SERVICES; LOSS OF USE, DATA, OR PROFITS;
# OR BUSINESS INTERRUPTION) HOWEVER CAUSED AND ON ANY THEORY OF LIABILITY,
# WHETHER IN CONTRACT, STRICT LIABILITY, OR TORT (INCLUDING NEGLIGENCE OR
# OTHERWISE) ARISING IN ANY WAY OUT OF THE USE OF THIS SOFTWARE, EVEN IF
# ADVISED OF THE POSSIBILITY OF SUCH DAMAGE.
#

config GREYBUS_TAPE_ARM_SEMIHOSTING
	bool "ARM Semihosting GB Taping"
	depends on ARCH_ARM
	select ARM_SEMIHOSTING
	default n
	---help---
		Greybus Tape provide a recording mechanism for incoming Greybus
		operations in order to replay them without needing an AP or UniPro.

config GREYBUS_CONTROL_PROTOCOL
	bool "Control Protocol support"
	default n

config GREYBUS_GPIO_PHY
	bool "GPIO PHY support"
	select GPIO
	default n

config GREYBUS_I2C_PHY
	bool "I2C PHY support"
	select I2C
	select I2C_TRANSFER
	default n

config GREYBUS_SPI_PHY
	bool "SPI PHY support"
	select DEVICE_CORE
	default n

config GREYBUS_BATTERY
	bool "Battery support"
	select DEVICE_CORE
	default n

config GREYBUS_MODS_I2S_PHY
	bool "Mods I2S support"
	default n

config GREYBUS_I2S_AUDIO
	bool "Audio support"
	default n

config GREYBUS_MODS_AUDIO
	bool "Mods Audio support"
	default n

if GREYBUS_MODS_AUDIO
choice
	prompt "Select a audio dev driver"
config GREYBUS_MODS_AUDIO_TFA9890
	bool "TFA9890"
config GREYBUS_MODS_AUDIO_DUMMY
	bool "DUMMY"
config GREYBUS_MODS_AUDIO_CUSTOM
	bool "Use custom audio chip driver"
endchoice
endif

config GREYBUS_TFA9890_I2C_BUS
	int "TFA9890 I2C Bus Number"
	default 1
	depends on GREYBUS_MODS_AUDIO_TFA9890
	---help---
		I2C bus to use to communicate with device (default 1).

if GREYBUS_MODS_AUDIO_TFA9890
choice
	prompt "Select a tfa9890 config mono or stereo"
config GREYBUS_MODS_AUDIO_TFA9890_STEREO
	bool "STEREO"
config GREYBUS_MODS_AUDIO_TFA9890_MONO
	bool "MONO"
endchoice
endif

config GREYBUS_TFA9890_LEFT_I2C_ADDR
	int "TFA9890 LEFT I2C ADDR"
	default 52
	depends on GREYBUS_MODS_AUDIO_TFA9890_STEREO
	---help---
		I2C addr to use to communicate with device (default 52).

config GREYBUS_TFA9890_RIGHT_I2C_ADDR
	int "TFA9890 RIGHT I2C ADDR"
	default 53
	depends on GREYBUS_MODS_AUDIO_TFA9890_STEREO
	---help---
		I2C addr to use to communicate with device (default 53).

config GREYBUS_TFA9890_MONO_I2C_ADDR
	int "TFA9890 MONO I2C ADDR"
	default 52
	depends on GREYBUS_MODS_AUDIO_TFA9890_MONO
	---help---
		I2C addr to use to communicate with device (default 53).

config GREYBUS_MODS_DISPLAY
	bool "Display support"
	select DEVICE_CORE
	default n

config GREYBUS_LOOPBACK
	bool "Loopback support"
	default n

config GREYBUS_VIBRATOR
	bool "Vibrator support"
	select GPIO
	default n

config GREYBUS_USB_HOST_PHY
	bool "USB Host PHY support"
	default n

config GREYBUS_PWM_PHY
	bool "PWM PHY support"
	select DEVICE_CORE
	default n

config GREYBUS_UART_PHY
	bool "UART PHY support"
	select DEVICE_CORE
	default n

config GREYBUS_HID
	bool "HID support"
	select DEVICE_CORE
	default n

config GREYBUS_SDIO_PHY
	bool "SDIO PHY support"
	select DEVICE_CORE
	default n

config GREYBUS_RAW
	bool "Vendor Raw Support"
	select DEVICE_CORE
	default n

config GREYBUS_VENDOR
	bool "Vendor Specific Protocol"
	default n

if GREYBUS_VENDOR
choice
	prompt "Select a vendor driver"
config GREYBUS_VENDOR_MOTO
	bool "Motorola"
endchoice
endif

config GREYBUS_NSH_UART
	bool "NSH UART support"
	default n

config GREYBUS_FIRMWARE
	bool "Greybus Firmware Flashing"
	select SCHED_WORKQUEUE
	select PROGMEM
	default n

if GREYBUS_FIRMWARE
	config FIRMWARE_FLASH_ADDRESS
	hex "Flash Target Base Address"
	default 0x08008000
		---help---
		Address on flash of the OS installation

	config FIRMWARE_CHUNK_SIZE
		hex "Chunk Size"
		default 1000
		---help---
		Maximum size to transport for flashing.  Limited
		by the maximum Greybus message size.
endif

config GREYBUS_PTP
	bool "Power transfer support"
	select DEVICE_CORE
	default n

if GREYBUS_PTP
choice
	prompt "Select Internal Source Send Power Capabilities"
config GREYBUS_PTP_INT_SND_NEVER
	bool "Never sent"
config GREYBUS_PTP_INT_SND_SUPPLEMENTAL
	bool "Sent with no restrictions"
config GREYBUS_PTP_INT_SND_LOW_BATT_SAVER
	bool "Sent when Handset battery is low"
endchoice

choice
	prompt "Select Internal Source Receive Power Capabilities"
config GREYBUS_PTP_INT_RCV_NEVER
	bool "Never received"
config GREYBUS_PTP_INT_RCV_FIRST
	bool "Received before Handset battery"
config GREYBUS_PTP_INT_RCV_SECOND
	bool "Received after Handset battery"
config GREYBUS_PTP_INT_RCV_PARALLEL
	bool "Received in parallel with Handset battery"
endchoice

choice
	prompt "Select External Power Sources Capabilities"
config GREYBUS_PTP_EXT_NONE
	bool "Not supported"
config GREYBUS_PTP_EXT_SUPPORTED
	bool "Supported"
endchoice
endif

menuconfig GREYBUS_SENSORS_EXT
	bool "Sensors-Ext Protocol"
	select DEVICE_CORE
	default n

if GREYBUS_SENSORS_EXT
config GREYBUS_SENSORS_EXT_DUMMY_PRESSURE
	bool "Dummy Pressure sensor"
	depends on RTC && SCHED_LPWORK
config GREYBUS_SENSORS_EXT_DUMMY_ACCEL
	bool "Dummy Accel Sensor"
	depends on RTC && SCHED_LPWORK
config GREYBUS_SENSORS_EXT_LSM9DS1_ACCEL
	bool "LSM9DS1 Accel Sensor"
	depends on RTC && I2C
endif

menuconfig GREYBUS_MODS
	bool "Mods Protocol"
	default n

if GREYBUS_MODS
source drivers/greybus/mods/Kconfig
endif

config GREYBUS_FEATURE_HAVE_TIMESTAMPS
	bool
	default n

config GREYBUS_LIGHTS
	bool "Lights support"
	select DEVICE_CORE
	default n

config GREYBUS_USB_EXT
	bool "MODS support for USB"
	select DEVICE_CORE
	select SCHED_WORKQUEUE
	select SCHED_LPWORK
	default n

config GREYBUS_CAMERA_EXT
	bool "Camera Extension"
	default n
```

## nuttx/drivers/greybus/mods/Kconfig
```kconfig
choice
	prompt "Select a Mods bus"
config GREYBUS_MODS_SPI
	bool "SPI"
	depends on GPIO
	depends on ARCH_HAVE_HIRES_TIMER

config GREYBUS_MODS_I2C
	bool "I2C"
	depends on GPIO
	select I2C
	select I2C_SLAVE

config GREYBUS_MODS_UART
	bool "UART"
endchoice

config GREYBUS_MODS_ATTACH
	bool "Mod Attach"
	select LIB_NOTIFIER
	default n
	---help---
		Include mod attach logic.

config GREYBUS_MODS_PORT
	int "Mods Port Number"
	default 1
	---help---
		Bus port to use to communicate with base (default 1).

config GREYBUS_MODS_I2C_ADDR
	hex "Mods I2C Address"
	depends on GREYBUS_MODS_I2C
	default 0x42

config GREYBUS_MODS_MAX_BUS_SPEED
	int "Mods Maximum Bus Speed"
	depends on GREYBUS_MODS_SPI || GREYBUS_MODS_I2C
	default 0
	---help---
		The maximum bus speed that will be reported to the AP. Set to zero to
		report nothing and remain at the default speed.

config GREYBUS_MODS_DESIRED_PKT_SIZE
	int "Mods Desired Packet Size"
	depends on GREYBUS_MODS_SPI || GREYBUS_MODS_I2C
	default 0
	---help---
		The desired packet size that will be reported to the AP. If the AP is
		unable to handle packets that large, the AP's maximum size will be used
		instead. Value must be greater than or equal to the default packet size
		and less than or equal to the maximum supported Greybus packet size.
		Set to zero to report nothing and remain at the default size.

config GREYBUS_MODS_ACK
	bool "Enable ACK support"
	depends on GREYBUS_MODS_SPI
	default y
	---help---
		When this option is enabled, an ACK is signaled to the base after each
		message to indicate the message was received correctly. This allows
		the transmitting side to know if there was an error during transmission
		(for example, CRC mismatch). This increases the reliability of the bus
		at the cost of speed, so do not enable this feature if you require low
		latency or high throughput.

config GREYBUS_MODS_PTP_DEVICE
	bool "PTP device to be used for charger and/or battery devices"
	default n
	depends on GREYBUS_PTP

select GREYBUS_MODS_PTP_DEVICE_HAS_BATTERY if GREYBUS_MODS_PTP_DEVICE && (!GREYBUS_PTP_INT_SND_NEVER || !GREYBUS_PTP_INT_RCV_NEVER)

menuconfig GREYBUS_MODS_PTP_DEVICE_HAS_BATTERY
	bool "PTP device has a battery"
	select BATTERY_STATE
	default n
	depends on GREYBUS_MODS_PTP_DEVICE

if GREYBUS_MODS_PTP_DEVICE_HAS_BATTERY
config GREYBUS_MODS_QUICK_CHG_CURRENT
	int "Quick charging current limit in mA"
	default 1500

config GREYBUS_MODS_FULL_CHG_VOLTAGE
	int "Full charging voltage limit in mV"
	default 4200

config GREYBUS_MODS_REDUCED_CHG_CURRENT
	int "Restricted charging current limit in mA"
	default 1000

config GREYBUS_MODS_REDUCED_CHG_VOLTAGE
	int "Restricted charging voltage limit in mV"
	default 4000

config GREYBUS_MODS_SLOW_CHG_CURRENT
	int "Slow charging current limit in mA"
	default 1000

config GREYBUS_MODS_INPUT_VOLTAGE_OFFSET
	int "Input voltage limit offset in mV"
	default 500

config GREYBUS_MODS_NORMAL_BATTERY_OUTPUT_CURRENT
	depends on !GREYBUS_PTP_INT_SND_NEVER
	int "Maximum output current from normal battery in mA"
	default 3000

config GREYBUS_MODS_LOW_BATTERY_OUTPUT_CURRENT
	depends on !GREYBUS_PTP_INT_SND_NEVER
	int "Maximum output current from low battery in mA"
	default 500

endif

config GREYBUS_MODS_MAX_VBUS_CURRENT
	depends on GREYBUS_MODS_PTP_DEVICE
	depends on (!GREYBUS_PTP_INT_SND_NEVER || !GREYBUS_PTP_INT_RCV_NEVER || GREYBUS_PTP_EXT_SUPPORTED)
	int "Maximum current through Mod VBUS connector in mA"
	default 3000

config GREYBUS_MODS_MAX_VBUS_VOLTAGE
	depends on GREYBUS_MODS_PTP_DEVICE
	depends on (!GREYBUS_PTP_INT_SND_NEVER || !GREYBUS_PTP_INT_RCV_NEVER || GREYBUS_PTP_EXT_SUPPORTED)
	int "Maximum voltage at Mod VBUS connector in mV"
	default 30000

config GREYBUS_MODS_PTP_CHG_DEVICE_SWITCH
	bool "PTP charger driver controlling power path through switches"
	default n
	depends on GREYBUS_MODS_PTP_DEVICE && GPIO

config GREYBUS_MODS_PTP_CHG_DEVICE_SWITCH_MAX_INPUT_VOLTAGE
	depends on GREYBUS_MODS_PTP_CHG_DEVICE_SWITCH && !GREYBUS_MODS_PTP_DEVICE_HAS_BATTERY
	int "Maximum voltage Mod with no battery can accept in mV"
	default 5000

if DEBUG
config GREYBUS_SELF_DESTRUCT
    bool "Support self blanking code - WARNING Debug release only"
    default n

if GREYBUS_SELF_DESTRUCT
    config GREYBUS_SELF_DESTRUCT_START
      hex  "Start address to erase"
      default 0x08000000

    config GREYBUS_SELF_DESTRUCT_END
      hex  "End address to erase"
      default 0x08007fff
endif
endif

config GREYBUS_MODS_HW_ROOT_VERSION
	hex "Pre-defined HW Root Version"
	default 0xff
	---help---
		The version/revision of the root hardware circuitry. This will
		communicate to the host/phone side what hardware features are
		supported by the mod. Valid values are 0x00 to 0xFF.

config GREYBUS_MODS_SUPPORT_VENDOR_UPDATES
	bool "Support APK update of firmware"
	default n
	---help---
		Should the Core allow APKs to update the firmware on this
		device.  If yes, then the mod must be responsible for validating
		the updates before applying them.
```

## nuttx/drivers/greybus/slice/Kconfig
```kconfig
choice
	prompt "Select a Slice bus"
config GREYBUS_SLICE_SPI
	bool "SPI"

config GREYBUS_SLICE_I2C
	bool "I2C"
endchoice

config GREYBUS_SLICE_PORT
	int "Slice Port Number"
	default 1
	---help---
		Bus port to use to communicate with base (default 1).

if GREYBUS_SLICE_I2C

config GREYBUS_SLICE_I2C_ADDR
	hex "Slice I2C Address"
	default 0x55

endif
```
